## build/Kconfig/boards/Kconfig
```kconfig
# Load Zephyr board Kconfig descriptions.
osource "/home/mnohem/ncs/zephyr/boards/nordic/nrf5340dk/Kconfig"
```

## build/output/Kconfig/Kconfig.shield
```kconfig
osource "/home/mnohem/ncs/nrfaudio/boards/shields/*/Kconfig.shield"
osource "/home/mnohem/ncs/nrf/boards/shields/*/Kconfig.shield"
```

## build/output/Kconfig/Kconfig.shield.defconfig
```kconfig
osource "/home/mnohem/ncs/nrfaudio/boards/shields/*/Kconfig.defconfig"
osource "/home/mnohem/ncs/nrf/boards/shields/*/Kconfig.defconfig"
```

## build/output/Kconfig/arch/Kconfig
```kconfig
# Load Zephyr Arch Kconfig descriptions.
osource "/home/mnohem/ncs/zephyr/arch/rx/Kconfig"
osource "/home/mnohem/ncs/zephyr/arch/x86/Kconfig"
osource "/home/mnohem/ncs/zephyr/arch/xtensa/Kconfig"
osource "/home/mnohem/ncs/zephyr/arch/sparc/Kconfig"
osource "/home/mnohem/ncs/zephyr/arch/riscv/Kconfig"
osource "/home/mnohem/ncs/zephyr/arch/posix/Kconfig"
osource "/home/mnohem/ncs/zephyr/arch/mips/Kconfig"
osource "/home/mnohem/ncs/zephyr/arch/arm64/Kconfig"
osource "/home/mnohem/ncs/zephyr/arch/arm/Kconfig"
osource "/home/mnohem/ncs/zephyr/arch/arc/Kconfig"
```

## build/output/Kconfig/boards/Kconfig.defconfig
```kconfig
# Load Zephyr board defconfig descriptions.
osource "/home/mnohem/ncs/zephyr/boards/nordic/nrf5340dk/Kconfig.defconfig"
```

## build/output/Kconfig/boards/Kconfig.nrf5340dk
```kconfig
# Load board Kconfig descriptions.
osource "/home/mnohem/ncs/zephyr/boards/nordic/nrf5340dk/Kconfig.nrf5340dk"
```
